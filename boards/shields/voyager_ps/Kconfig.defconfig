## boards/shields/voyager_ps/Kconfig.defconfig
```kconfig
if SHIELD_VOYAGER_PS_LEFT

config ZMK_KEYBOARD_NAME
    default "voyager-ps"

config ZMK_SPLIT_ROLE_CENTRAL
    default y

endif # SHIELD_VOYAGER_PS_LEFT

if SHIELD_VOYAGER_PS_LEFT || SHIELD_VOYAGER_PS_RIGHT

config ZMK_SPLIT
    default y

endif # SHIELD_VOYAGER_PS_LEFT || SHIELD_VOYAGER_PS_RIGHT
```

## boards/shields/voyager_ps/Kconfig.shield
```kconfig
config SHIELD_VOYAGER_PS_LEFT
    def_bool $(shields_list_contains,voyager_ps_left)

config SHIELD_VOYAGER_PS_RIGHT
    def_bool $(shields_list_contains,voyager_ps_right)
```
